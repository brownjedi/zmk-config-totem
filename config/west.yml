## config/west.yml
```yaml
manifest:
  remotes:
    - name: zmkfirmware
      url-base: https://github.com/zmkfirmware
    - name: zzeneg # <-- required for Raw HID module
      url-base: https://github.com/zzeneg
    - name: srwi # <-- required for KeyPeek module
      url-base: https://github.com/srwi
  projects:
    - name: zmk
      remote: zmkfirmware
      revision: 484a0547078228f6957ed164523823e39fbedec4
      import: app/west.yml
    - name: zmk-raw-hid # <-- Raw HID module
      remote: zzeneg
      revision: e25e325adc90fccb60cc08393b8c2b0ba6d647c7
    - name: zmk-keypeek-layer-notifier # <-- KeyPeek module
      remote: srwi
      revision: b600af3bb7d1795073a4ce23e08d6db46371551b
  self:
    path: config
```
